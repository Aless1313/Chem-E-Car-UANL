
// LIBRERIAS USADAS
#include <Wire.h>
#include <Adafruit_SSD1306.h>
#include <Adafruit_TCS34725.h>

// Definición de las pantallas OLED
#define OLED_RESET 4
Adafruit_SSD1306 display(OLED_RESET);

// Definición de pines
#define motor 33
#define stopPin 27
#define buttonStartPin 26
#define resetbutton 25

// Variables booleanas
bool motorDetenido = true; // Inicialmente, el motor está detenido
bool buttonStartPressed = false;

// Definición de sensor de color
Adafruit_TCS34725 tcs = Adafruit_TCS34725(TCS34725_INTEGRATIONTIME_50MS, TCS34725_GAIN_4X);

// valores hexadecimales para imprimir imagenes
const unsigned char chofer[] PROGMEM = {
    0xff, 0xff, 0xff, 0xff, 0xff, 0xff, 0xff, 0xff, 0xff, 0xff, 0xff, 0xff, 0xff, 0xff, 0xff, 0xff,
    0xff, 0xff, 0xff, 0xff, 0xff, 0xff, 0xff, 0xff, 0xff, 0xff, 0xff, 0xff, 0xff, 0xff, 0xff, 0xff,
    0xff, 0xff, 0xff, 0xff, 0xff, 0xff, 0xff, 0xff, 0xff, 0xff, 0xff, 0xff, 0xff, 0xff, 0xff, 0xff,
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    0xff, 0xff, 0xff, 0xff, 0xff, 0xff, 0xff, 0xff, 0xff, 0xff, 0xff, 0xff, 0xff, 0xff, 0xff, 0xff};
const unsigned char stop[] PROGMEM = {
    0xff, 0xff, 0xff, 0xff, 0xff, 0xff, 0xff, 0xff, 0xff, 0xff, 0xff, 0xff, 0xff, 0xff, 0xff, 0xff,
    0xff, 0xff, 0xff, 0xff, 0xff, 0xff, 0xff, 0xff, 0xff, 0xff, 0xff, 0xff, 0xff, 0xff, 0xff, 0xff,
    0xff, 0xff, 0xff, 0xff, 0xff, 0xff, 0xff, 0xff, 0xff, 0xff, 0xff, 0xff, 0xff, 0xff, 0xff, 0xff,
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    0xff, 0xff, 0xff, 0xff, 0xff, 0xff, 0xff, 0xff, 0xff, 0xff, 0xff, 0xff, 0xff, 0xff, 0xff, 0xff};

// Array de los bitmaps
const int epd_bitmap_allArray_LEN = 2;
const unsigned char *epd_bitmap_allArray[2] = {
    chofer,
    stop};

// FUNCION SETUP
void setup()
{
  // Para imprimir valores en pc (modo de pruebas)
  Serial.begin(9600);

  // Iniciar pantallas OLED
  if (!display.begin(SSD1306_SWITCHCAPVCC, 0x3C))
  {
    Serial.println(F("No se pudo iniciar la pantalla OLED SSD1306"));
    for (;;)
      ;
  }

  // Verificar pantalla
  display.display();
  display.clearDisplay();

  // Esta sección previene que el robot se inicie si no detecta sensor de color
  // Si llega a aparecer este error, revisar las conexiones al sensor
  if (!tcs.begin())
  {
    display.setTextSize(1);
    display.setTextColor(WHITE);
    display.setCursor(0, 0);
    display.print("SENSOR NO DETECTADO");
    display.display();

    // Serial.println("No se pudo encontrar el sensor TCS34725. Verifique la conexión!");
    while (1)
      ;
  }

  // Serial.println("Encontrado sensor TCS34725");
  display.clearDisplay();
  display.setTextSize(1);
  display.setTextColor(WHITE);
  display.setCursor(0, 0);
  display.print("SENSOR DETECTADO");
  display.display();
  delay(400);

  // Imprimir el chofer en pantalla
  display.display();
  display.clearDisplay();
  display.drawBitmap(0, 0, chofer, 128, 64, WHITE);
  display.display();

  // Definicion de los botones y motor
  pinMode(stopPin, INPUT_PULLUP);        // Usar pull-up interno
  pinMode(buttonStartPin, INPUT_PULLUP); // Usar pull-up interno
  pinMode(resetbutton, INPUT);
  pinMode(motor, OUTPUT);
}

void run()
{

  // Mientras el botón de stop no se haya presionado
  while (!digitalRead(stopPin))
  {
    // Variables para detectar coloración
    uint16_t clear, red, green, blue;
    tcs.getRawData(&red, &green, &blue, &clear);

    // Serial.print("Rojo: ");
    // Serial.print(red);
    // Serial.print(" Verde: ");
    // Serial.print(green);
    // Serial.print(" Azul: ");
    // Serial.print(blue);
    // Serial.println();

    // Si el motor está en marcha y se presiona el botón de parada
    if (digitalRead(stopPin) == HIGH)
    {
      digitalWrite(motor, LOW); // Detener el motor
      motorDetenido = false;

      // Imprimir STOP
      display.clearDisplay();
      display.drawBitmap(0, 0, stop, 128, 64, WHITE);
      display.display();

      // display.setTextSize(1);
      // display.setTextColor(WHITE);
      // display.setCursor(0, 0);
      // display.print("STOP");
      // display.display();
    }

    // Si la coloración esta en el rango de solución blanca
    if (red > 300 && green > 300 && blue > 300)
    {
      // Activar el motor
      digitalWrite(motor, HIGH);
    }
    else
    {
      // Detener el motor
      digitalWrite(motor, LOW);

      // Imprimir STOP
      display.clearDisplay();
      display.drawBitmap(0, 0, stop, 128, 64, WHITE);
      display.display();

      // display.setTextSize(1);
      // display.setTextColor(WHITE);
      // display.setCursor(0, 0);
      // display.print("STOP");
      // display.display();

      motorDetenido = true;
      return; // Salir de la función run() si el botón de STOP se presiona
    }
  }
}

void loop()
{

  // Si el motor está en marcha y se presiona el botón de parada
  if (!motorDetenido && digitalRead(stopPin))
  {
    digitalWrite(motor, LOW); // Detener el motor

    // Imprimir STOP
    display.clearDisplay();
    display.drawBitmap(0, 0, stop, 128, 64, WHITE);
    display.display();

    motorDetenido = true;

    // display.setTextSize(1);
    // display.setTextColor(WHITE);
    // display.setCursor(0, 0);
    // display.print("STOP");
    // display.display();
  }

  // Para prevenir que arranque una vez detenido
  if (!motorDetenido)
  {
    digitalWrite(motor, LOW); // Detener el motor

    // Imprimir STOP
    display.clearDisplay();
    display.drawBitmap(0, 0, stop, 128, 64, WHITE);
    display.display();
  }

  // Resetear (Boton Azul) Recomendado presionar antes de cada ronda para reiniciar variables booleanas
  if (digitalRead(resetbutton) == HIGH)
  {
    ESP.restart();
  }

  // Si se presiona star (Boton verde)
  if (digitalRead(buttonStartPin) == HIGH && !buttonStartPressed)
  {
    buttonStartPressed = true;

    // display.clearDisplay();
    // display.setTextSize(1);
    // display.setTextColor(WHITE);
    // display.setCursor(0, 0);
    // display.print("RUN");
    // display.display();

    motorDetenido = false;

    run(); // Iniciar la función run()
  }
}
